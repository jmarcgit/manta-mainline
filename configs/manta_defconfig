## configs/manta_defconfig
```kconfig
CONFIG_CMDLINE=""
CONFIG_DEFAULT_INIT="/init"
CONFIG_PANIC_TIMEOUT=5

# CONFIG_ATAGS is not set
CONFIG_ARM_APPENDED_DTB=y
CONFIG_ARM_ATAG_DTB_COMPAT=y
CONFIG_ARM_ATAG_DTB_COMPAT_CMDLINE_EXTEND=y

CONFIG_SYSVIPC=y
CONFIG_NO_HZ=y
CONFIG_HIGH_RES_TIMERS=y
CONFIG_PREEMPT=y
CONFIG_SMP=y
CONFIG_SCHED_MC=y
CONFIG_CGROUPS=y
CONFIG_SECCOMP=y
CONFIG_HIGHMEM=y
CONFIG_NR_CPUS=2
CONFIG_PM=y
CONFIG_ARCH_EXYNOS=y

CONFIG_I2C=y
CONFIG_I2C_CHARDEV=y
CONFIG_I2C_MUX=y
CONFIG_I2C_ARB_GPIO_CHALLENGE=y
CONFIG_I2C_GPIO=y

CONFIG_SPI=y
CONFIG_SPI_GPIO=y
CONFIG_SPI_S3C64XX=y

CONFIG_COMMON_CLK_MAX77686=y

CONFIG_BLK_DEV_INITRD=y
CONFIG_DEVTMPFS=y
CONFIG_DEVTMPFS_MOUNT=y

CONFIG_WATCHDOG=y
CONFIG_S3C2410_WATCHDOG=y

CONFIG_INPUT_TOUCHSCREEN=y
CONFIG_TOUCHSCREEN_ATMEL_MXT=y

# CONFIG_INPUT_KEYBOARD is not set

# CONFIG_INPUT_MOUSE is not set

CONFIG_DRM=y
CONFIG_DRM_EXYNOS=y
CONFIG_DRM_EXYNOS_FIMD=y
CONFIG_DRM_EXYNOS_MIXER=y
CONFIG_DRM_EXYNOS_HDMI=y
CONFIG_DRM_PANEL_SIMPLE=y
CONFIG_DRM_PANFROST=y
CONFIG_FB=y
CONFIG_LCD_CLASS_DEVICE=y
CONFIG_LCD_PLATFORM=y

CONFIG_BACKLIGHT_CLASS_DEVICE=y
CONFIG_PWM=y
CONFIG_BACKLIGHT_PWM=y

CONFIG_SOUND=y
CONFIG_SND=y
CONFIG_SND_SOC=y
CONFIG_SND_SOC_SAMSUNG=y
CONFIG_SND_SOC_SAMSUNG_MIDAS_WM1811=y

CONFIG_MFD_MAX77686=y

CONFIG_REGULATOR=y
CONFIG_REGULATOR_FIXED_VOLTAGE=y
CONFIG_REGULATOR_MAX77686=y

CONFIG_ARM_ERRATA_798181=y

CONFIG_EXPERT=y
CONFIG_TRIM_UNUSED_KSYMS=y
CONFIG_CC_OPTIMIZE_FOR_SIZE=y
```
